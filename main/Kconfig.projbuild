## main/Kconfig.projbuild
```kconfig
menu "Application Top Level Configuration"
	menu "SD Card Example menu"

		config EXAMPLE_FORMAT_IF_MOUNT_FAILED
			bool "Format the card if mount failed"
			default n
			help
				If this config item is set, format_if_mount_failed will be set to true and the card will be formatted if
				the mount has failed.
	endmenu
	menu "WiFi SoftAP Configuration"
		config ESP_WIFI_SSID
			string "WiFi SSID"
			default "myssid"
			help
				SSID (network name) for the example to connect to.

		config ESP_WIFI_PASSWORD
			string "WiFi Password"
			default "mypassword"
			help
				WiFi password (WPA or WPA2) for the example to use.
		config ESP_WIFI_CHANNEL
			int "WiFi Channel"
			range 1 13
			default 1
			help
				WiFi channel (network channel) for the example to use.

		config ESP_MAX_STA_CONN
			int "Maximal STA connections"
			default 4
			help
				Max number of the STA connects to AP.
	endmenu
	menu "UDP Client Broadcast Configuration"

		choice EXAMPLE_IP_MODE
			prompt "IP Version"
			depends on EXAMPLE_SOCKET_IP_INPUT_STRING
			help
				Example can use either IPV4 or IPV6.
	
			config EXAMPLE_IPV4
				bool "IPV4"
	
			config EXAMPLE_IPV6
				bool "IPV6"
				select EXAMPLE_CONNECT_IPV6
	
		endchoice
	
		config EXAMPLE_IPV4_ADDR
			string "IPV4 Address"
			default "192.168.0.255"
			depends on EXAMPLE_IPV4
			help
				IPV4 address to which the client example will send data.
	
		config EXAMPLE_IPV6_ADDR
			string "IPV6 Address"
			default "FE80::30AD:E57B:C212:68AD"
			depends on EXAMPLE_IPV6
			help
				IPV6 address to which the client example will send data.
	
		config EXAMPLE_PORT
			int "Port"
			range 0 65535
			default 3333
			help
				The remote port to which the client example will send data.
	
		choice EXAMPLE_SOCKET_IP_INPUT
			prompt "Socket example source"
			default EXAMPLE_SOCKET_IP_INPUT_STRING
			help
				Selects the input source of the IP used in the example.
	
			config EXAMPLE_SOCKET_IP_INPUT_STRING
				bool "From string"
	
			# config EXAMPLE_SOCKET_IP_INPUT_STDIN
			# 	bool "From stdin"
		endchoice
	
	endmenu
	menu "UARTs Configuration"
		config EXAMPLE_UART_PORT_NUM
			int "UART port number"
			range 0 2 if IDF_TARGET_ESP32   || IDF_TARGET_ESP32S3
			range 0 1 if IDF_TARGET_ESP32S2 || IDF_TARGET_ESP32C3
			default 2 if IDF_TARGET_ESP32   || IDF_TARGET_ESP32S3
			default 1 if IDF_TARGET_ESP32S2 || IDF_TARGET_ESP32C3
			help
				UART communication port number for the example.
				See UART documentation for available port numbers.

		config EXAMPLE_UART_BAUD_RATE
			int "UART communication speed"
			range 1200 115200
			default 115200
			help
				UART communication speed for Modbus example.

		config EXAMPLE_UART_RXD
			int "UART RXD pin number"
			range 0 34 if IDF_TARGET_ESP32
			range 0 46 if IDF_TARGET_ESP32S2 || IDF_TARGET_ESP32S3
			range 0 19 if IDF_TARGET_ESP32C3
			default 5
			help
				GPIO number for UART RX pin. See UART documentation for more information
				about available pin numbers for UART.

		config EXAMPLE_UART_TXD
			int "UART TXD pin number"
			range 0 34 if IDF_TARGET_ESP32
			range 0 46 if IDF_TARGET_ESP32S2 || IDF_TARGET_ESP32S3
			range 0 19 if IDF_TARGET_ESP32C3
			default 4
			help
				GPIO number for UART TX pin. See UART documentation for more information
				about available pin numbers for UART.

		config EXAMPLE_TASK_STACK_SIZE
			int "UART echo example task stack size"
			range 1024 16384
			default 2048
			help
				Defines stack size for UART echo example. Insufficient stack size can cause crash.

	endmenu

	menu "I2C Configuration"
		menu "I2C Master"
			config I2C_MASTER_SCL
				int "SCL GPIO Num"
				default 6 if IDF_TARGET_ESP32C3
				default 2 if  IDF_TARGET_ESP32S3
				default 19 if IDF_TARGET_ESP32 || IDF_TARGET_ESP32S2
				help
					GPIO number for I2C Master clock line.

			config I2C_MASTER_SDA
				int "SDA GPIO Num"
				default 5 if IDF_TARGET_ESP32C3
				default 1 if  IDF_TARGET_ESP32S3
				default 18 if IDF_TARGET_ESP32 || IDF_TARGET_ESP32S2
				help
					GPIO number for I2C Master data line.

			config I2C_MASTER_PORT_NUM
				int "Port Number"
				default 1 if IDF_TARGET_ESP32 || IDF_TARGET_ESP32S2 || IDF_TARGET_ESP32S3
				default 0 if IDF_TARGET_ESP32C3
				help
					Port number for I2C Master device.

			config I2C_MASTER_FREQUENCY
				int "Master Frequency"
				default 100000
				help
					I2C Speed of Master device.
		endmenu


		menu "BH1750 Sensor"
			choice BH1750_ADDR
				prompt "BH1750 I2C Address"
				default BH1750_I2C_ADDRESS_LOW
				help
					Hardware address of BH1750, which is 2 types, and determined by ADDR terminal.

				config BH1750_I2C_ADDRESS_LOW
					bool "BH1750 I2C Address(ADDR=0)"
					help
						I2C Address of BH1750 Sensor according to your schemetic configuration.

				config BH1750_I2C_ADDRESS_High
					bool "BH1750 I2C Address(ADDR=1)"
					help
						I2C Address of BH1750 Sensor according to your schemetic configuration.
			endchoice

			config BH1750_ADDR
				hex
				default 0x5C if BH1750_I2C_ADDRESS_High
				default 0x23 if BH1750_I2C_ADDRESS_LOW

			choice BH1750_MODE
				prompt "BH1750 Operation Mode"
				default BH1750_ONETIME_L_RESOLUTION
				help
					Operation Mode of BH1750.
					Different mode means different resolution and measurement time.
				config BH1750_CONTINU_H_RESOLUTION
					bool "Continuously H-Resolution Mode"
					help
						Resolution is 1lx, measurement time is typically 120ms.
				config BH1750_CONTINU_H_RESOLUTION2
					bool "Continuously H-Resolution Mode2"
					help
						Resolution is 0.5lx, measurement time is typically 120ms.
				config BH1750_CONTINU_L_RESOLUTION
					bool "Continuously L-Resolution Mode"
					help
						Resolution is 4lx, measurement time is typically 16ms.
				config BH1750_ONETIME_H_RESOLUTION
					bool "One Time H-Resolution Mode"
					help
						Resolution is 1lx, measurement time is typically 120ms.
						It is automatically set to Power Down mode after measurement.
				config BH1750_ONETIME_H_RESOLUTION2
					bool "One Time H-Resolution Mode2"
					help
						Resolution is 0.5lx, measurement time is typically 120ms.
						It is automatically set to Power Down mode after measurement.
				config BH1750_ONETIME_L_RESOLUTION
					bool "One Time L-Resolution Mode"
					help
						Resolution is 4lx, measurement time is typically 16ms.
						It is automatically set to Power Down mode after measurement.
			endchoice

			config BH1750_OPMODE
				hex
				default 0x10 if BH1750_CONTINU_H_RESOLUTION
				default 0x11 if BH1750_CONTINU_H_RESOLUTION2
				default 0x13 if BH1750_CONTINU_L_RESOLUTION
				default 0x20 if BH1750_ONETIME_H_RESOLUTION
				default 0x21 if BH1750_ONETIME_H_RESOLUTION2
				default 0x23 if BH1750_ONETIME_L_RESOLUTION

		endmenu

	endmenu
endmenu
```
